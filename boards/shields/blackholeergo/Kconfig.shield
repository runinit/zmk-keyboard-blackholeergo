## boards/shields/blackholeergo/Kconfig.shield
```kconfig
config SHIELD_BLACKHOLEERGO_LEFT
    def_bool $(shields_list_contains,blackholeergo_left)

config SHIELD_BLACKHOLEERGO_RIGHT
    def_bool $(shields_list_contains,blackholeergo_right)
```

## west.yml
```yaml
manifest:
  remotes:
    - name: zmkfirmware
      url-base: https://github.com/zmkfirmware
    - name: blackholeergo
      url-base: https://github.com/runinit/zmk-keyboard-blackholeergo
  projects:
    # Together with the above defined remote, this refers to a module located at
    # https://github.com/remote-name/repository-name
    - name: zmk
      remote: zmkfirmware
      revision: main
      import: app/west.yml
    - name: zmk-keyboard-blackholeergo
      remote: runinit
      revision: main
      # This points to a west manifest file in the remote module for further imports
      import: west.yml
```
